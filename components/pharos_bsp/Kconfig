## components/pharos_bsp/Kconfig
```kconfig
menu "Pharos board"

config PHAROS_HAS_VENDOR_BSP
    bool "Drive the real Waveshare panel"
    default y
    help
        ON by default: brings up the CO5300 AMOLED, the CST9217 touch
        controller and LVGL through the Waveshare managed BSP, exactly as
        their own example does. This is what puts pixels on the screen.

        Turn it OFF only to build for a bare ESP32-S3 module with no panel
        attached - the firmware still runs and logs over serial, but the
        display stays dark.

endmenu
```
